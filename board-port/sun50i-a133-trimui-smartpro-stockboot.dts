// SPDX-License-Identifier: (GPL-2.0+ OR MIT)
/*
 * TEST ONLY, not for upstream: for booting mainline from the stock vendor
 * U-Boot with the vendor-initialised display left running. Keeps the stock
 * boot-logo framebuffer (cmdline disp_reserve=3686400,0x7b81d480) out of the
 * kernel's hands so the logo stays intact while the display is inspected.
 */

#include "sun50i-a133-trimui-smartpro.dts"

/ {
	reserved-memory {
		#address-cells = <2>;
		#size-cells = <2>;
		ranges;

		framebuffer@7b81d000 {
			reg = <0x0 0x7b81d000 0x0 0x385000>;
			no-map;
		};
	};
};
